## components/esp_secure_cert_mgr/Kconfig
```kconfig
menu "esp_secure_cert_mgr"

   choice ESP_SECURE_CERT_PARTITION_TYPE
        prompt "Choose the type of esp_secure_cert partition"
        default ESP_SECURE_CERT_CUST_FLASH_PARTITION
        help
            The Pre-prov components support two type of partitions for reading the contents.
            NVS partition and custom flash partition.
            Select the appropriate type of partition.

        config ESP_SECURE_CERT_NVS_PARTITION
            bool "NVS partition"
        config ESP_SECURE_CERT_CUST_FLASH_PARTITION
            bool "Custom flash partition"
    endchoice


    config ESP_SECURE_CERT_PARTITION_NAME
        string "Name of the secure cert partition"
        default "esp_secure_cert"
        help
            The name of the secure_cert_partition. Should match the pre-provisioned partition. This should be not be changed from the default value unless requied.

    config ESP_SECURE_CERT_KEYS_PARTITION_NAME
        string "Name of the nvs keys partition"
        depends on ESP_SECURE_CERT_NVS_PARTITION
        default "esp_secure_cert_keys"
        help
            The name of the secure_cert_partition. Should match the pre-provisioned partition. This should be not be changed from the default value unless requied.

    config ESP_SECURE_CERT_DS_PERIPHERAL
        bool "Enable DS peripheral support"
        default y
        depends on !IDF_TARGET_ESP32
        help
            Enable the DS peripheral support. Not supported on esp32.

endmenu #esp_secure_cert_mgr
```

## components/esp_secure_cert_mgr/examples/esp_secure_cert_sample_app/sdkconfig.defaults
```kconfig
CONFIG_PARTITION_TABLE_CUSTOM=y
CONFIG_PARTITION_TABLE_OFFSET=0xc000
CONFIG_PARTITION_TABLE_CUSTOM_FILENAME="partitions_custflash.csv"
CONFIG_ESP_SECURE_CERT_CUST_FLASH_PARTITION=y
```

## components/espressif__esp_secure_cert_mgr/examples/esp_secure_cert_app/sdkconfig.defaults
```kconfig
CONFIG_PARTITION_TABLE_CUSTOM=y
CONFIG_PARTITION_TABLE_OFFSET=0xc000
CONFIG_PARTITION_TABLE_CUSTOM_FILENAME="partitions.csv"
```
