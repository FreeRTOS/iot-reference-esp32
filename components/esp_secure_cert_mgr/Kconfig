## sdkconfig.defaults
```kconfig
CONFIG_IDF_TARGET=esp32c3
CONFIG_PARTITION_TABLE_CUSTOM=y
CONFIG_PARTITION_TABLE_CUSTOM_FILENAME="partitions.csv"
CONFIG_PARTITION_TABLE_FILENAME="partitions.csv"
CONFIG_PARTITION_TABLE_OFFSET=0xb000
CONFIG_APP_WIFI_PROV_SHOW_QR=y
CONFIG_APP_WIFI_PROV_TRANSPORT_BLE=y
CONFIG_APP_WIFI_PROV_TRANSPORT=2
CONFIG_GRI_ENABLE_SIMPLE_PUB_SUB_DEMO=y
CONFIG_GRI_ENABLE_TEMPERATURE_LED_PUB_SUB_DEMO=y
CONFIG_GRI_ENABLE_OTA_DEMO=y
CONFIG_BT_ENABLED=y
CONFIG_BT_NIMBLE_ENABLED=y
CONFIG_MBEDTLS_THREADING_C=y
CONFIG_MBEDTLS_THREADING_ALT=n
CONFIG_MBEDTLS_THREADING_PTHREAD=y
CONFIG_ESPTOOLPY_FLASHSIZE_4MB=y
CONFIG_BOOTLOADER_APP_ROLLBACK_ENABLE=y
CONFIG_BOOTLOADER_LOG_LEVEL_ERROR=y
CONFIG_OTA_DATA_OVER_HTTP=n
CONFIG_OTA_DATA_OVER_MQTT=y
CONFIG_OTA_DATA_OVER_MQTT_PRIMARY=y
CONFIG_OTA_PRIMARY_DATA_PROTOCOL=1
CONFIG_ESP_SECURE_CERT_DS_PERIPHERAL=n
CONFIG_ESP_SECURE_CERT_SUPPORT_LEGACY_FORMATS=y
CONFIG_GRI_SUB_PUB_UNSUB_DEMO_MAX_COMMAND_SEND_BLOCK_TIME_MS=10000
CONFIG_GRI_SUB_PUB_UNSUB_DEMO_DELAY_BETWEEN_SUB_PUB_UNSUB_LOOPS_MS=10000
CONFIG_GRI_MQTT_AGENT_CONNACK_RECV_TIMEOUT_MS=10000

# Set optimization for size
CONFIG_COMPILER_OPTIMIZATION_SIZE=y

# Set default FreeRTOS Stack sizes
CONFIG_FREERTOS_TIMER_TASK_STACK_DEPTH=1536
CONFIG_FREERTOS_IDLE_TASK_STACKSIZE=1024

# LWIP config
CONFIG_LWIP_MAX_SOCKETS=8

# AWS OTA
CONFIG_LOG2_FILE_BLOCK_SIZE=12
CONFIG_MAX_NUM_BLOCKS_REQUEST=8
CONFIG_GRI_OTA_MAX_NUM_DATA_BUFFERS=2
CONFIG_ALLOW_DOWNGRADE=0
CONFIG_OTA_DATA_OVER_MQTT=y
# CONFIG_OTA_DATA_OVER_HTTP is not set
CONFIG_OTA_DATA_OVER_MQTT_PRIMARY=y
CONFIG_OTA_PRIMARY_DATA_PROTOCOL=1

# MbedTLS Config Options
CONFIG_MBEDTLS_TLS_SERVER_AND_CLIENT=n
# CONFIG_MBEDTLS_TLS_SERVER_ONLY is not set
# CONFIG_MBEDTLS_TLS_CLIENT_ONLY is not set
# CONFIG_MBEDTLS_TLS_DISABLED is not set
CONFIG_MBEDTLS_TLS_SERVER=n
CONFIG_MBEDTLS_SERVER_SSL_SESSION_TICKETS=n
CONFIG_MBEDTLS_TLS_CLIENT=y
CONFIG_MBEDTLS_TLS_ENABLED=y


#
# Unity unit testing library
#
CONFIG_UNITY_ENABLE_FIXTURE=y

CONFIG_BT_ENABLED=y
CONFIG_BT_NIMBLE_ENABLED=y
CONFIG_BT_NIMBLE_50_FEATURE_SUPPORT=n

CONFIG_BLINK_LED_GPIO=y
CONFIG_BLINK_GPIO=8

CONFIG_BT_NIMBLE_MAX_ATTRIBUTES=256
CONFIG_BT_NIMBLE_MAX_SERVICES=64
CONFIG_BT_NIMBLE_MAX_CHARACTERISTICS=128
CONFIG_BT_NIMBLE_MAX_DESCRIPTORS=256


#
# ESP-MQTT Configurations
#
CONFIG_MQTT_PROTOCOL_311=y
# CONFIG_MQTT_PROTOCOL_5 is not set
CONFIG_MQTT_TRANSPORT_SSL=y
CONFIG_MQTT_TRANSPORT_WEBSOCKET=y
CONFIG_MQTT_TRANSPORT_WEBSOCKET_SECURE=y
# CONFIG_MQTT_MSG_ID_INCREMENTAL is not set
# CONFIG_MQTT_SKIP_PUBLISH_IF_DISCONNECTED is not set
# CONFIG_MQTT_REPORT_DELETED_MESSAGES is not set
CONFIG_MQTT_USE_CUSTOM_CONFIG=y
CONFIG_MQTT_TCP_DEFAULT_PORT=1883
CONFIG_MQTT_SSL_DEFAULT_PORT=8883
CONFIG_MQTT_WS_DEFAULT_PORT=80
CONFIG_MQTT_WSS_DEFAULT_PORT=443
CONFIG_MQTT_BUFFER_SIZE=1024
CONFIG_MQTT_TASK_STACK_SIZE=8192
# CONFIG_MQTT_DISABLE_API_LOCKS is not set
CONFIG_MQTT_TASK_PRIORITY=5
CONFIG_MQTT_POLL_READ_TIMEOUT_MS=1000
CONFIG_MQTT_EVENT_QUEUE_SIZE=1
# CONFIG_MQTT_TASK_CORE_SELECTION_ENABLED is not set
# CONFIG_MQTT_OUTBOX_DATA_ON_EXTERNAL_MEMORY is not set
# CONFIG_MQTT_CUSTOM_OUTBOX is not set
CONFIG_MQTT_OUTBOX_EXPIRED_TIMEOUT_MS=30000
# end of ESP-MQTT Configurations

CONFIG_MBEDTLS_HKDF_C=y
```
